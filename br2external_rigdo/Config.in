## br2external_rigdo/Config.in
```kconfig
source "$BR2_EXTERNAL_rigdo_PATH/package/libwt/Config.in"
source "$BR2_EXTERNAL_rigdo_PATH/package/localgui/Config.in"
source "$BR2_EXTERNAL_rigdo_PATH/package/xmrig/Config.in"
source "$BR2_EXTERNAL_rigdo_PATH/package/xmrig-proxy/Config.in"
source "$BR2_EXTERNAL_rigdo_PATH/package/ethminer/Config.in"
source "$BR2_EXTERNAL_rigdo_PATH/package/libhsakmt/Config.in"
source "$BR2_EXTERNAL_rigdo_PATH/package/libhsart/Config.in"
source "$BR2_EXTERNAL_rigdo_PATH/package/ex-nvidia-driver/Config.in"
source "$BR2_EXTERNAL_rigdo_PATH/package/libamdocl64/Config.in"
source "$BR2_EXTERNAL_rigdo_PATH/package/oclicd/Config.in"
source "$BR2_EXTERNAL_rigdo_PATH/package/librocmsmi/Config.in"
```

## br2external_rigdo/package/ethminer/Config.in
```kconfig
config BR2_PACKAGE_ETHMINER
	bool "ethminer"
	depends on BR2_PACKAGE_LIBUV
	help
	  Etherium  OpenCL/CUDA GPU miner
```

## br2external_rigdo/package/libamdocl64/Config.in
```kconfig
config BR2_PACKAGE_LIBAMDOCL64
	bool "libamdocl64"
	select BR2_PACKAGE_MESA3D_HEADERS
	select BR2_PACKAGE_HAS_LIBOPENCL
	help
	  amd rocm opencl

config BR2_PACKAGE_PROVIDES_LIBOPENCL
    default "libamdocl64" if BR2_PACKAGE_LIBAMDOCL64
```

## br2external_rigdo/package/libhsakmt/Config.in
```kconfig
config BR2_PACKAGE_LIBHSAKMT
	bool "libhsakmt"
	depends on BR2_PACKAGE_NUMACTL
	help
	  rocm: ROCT-Thunk-Interface
	  https://github.com/RadeonOpenCompute/ROCT-Thunk-Interface.git
```

## br2external_rigdo/package/libhsart/Config.in
```kconfig
config BR2_PACKAGE_LIBHSART
	bool "libhsakmt"
	depends on BR2_PACKAGE_ELFUTILS
	depends on BR2_PACKAGE_LIBHSAKMT
	help
	  rocm: ROCR-Runtime
	  https://github.com/RadeonOpenCompute/ROCR-Runtime.git
```

## br2external_rigdo/package/librocmsmi/Config.in
```kconfig
config BR2_PACKAGE_LIBROCMSMI
	bool "librocmsmi"
	help
	  ROCm System Management Interface (ROCm SMI) Library
	  https://github.com/RadeonOpenCompute/rocm_smi_lib.git
```

## br2external_rigdo/package/oclicd/Config.in
```kconfig
config BR2_PACKAGE_OCLICD
	bool "oclicd"
	select BR2_PACKAGE_MESA3D_HEADERS
	select BR2_PACKAGE_HAS_LIBOPENCL
	help
	  ocl icd loader

config BR2_PACKAGE_PROVIDES_LIBOPENCL
    default "oclicd" if BR2_PACKAGE_OCLICD
```

## br2external_rigdo/package/xmrig-proxy/Config.in
```kconfig
config BR2_PACKAGE_XMRIG_PROXY
	bool "xmrig-proxy"
	depends on BR2_PACKAGE_LIBUV
	help
	  XMRig Proxy
```

## br2external_rigdo/package/xmrig/Config.in
```kconfig
config BR2_PACKAGE_XMRIG
	bool "xmrig"
	depends on BR2_PACKAGE_LIBUV
	help
	  Monero (XMR) CPU miner
```
